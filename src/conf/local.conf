## src/conf/local.conf
```bitbake
# Machine Selection
# MACHINE ??= "qemuarm"
MACHINE ??= "raspberrypi0-wifi"

# Where to place downloads
#DL_DIR ?= "${TOPDIR}/downloads"

# Where to place shared-state files
#SSTATE_DIR ?= "${TOPDIR}/sstate-cache"

# Where to place the build output
#TMPDIR = "${TOPDIR}/tmp"

# Default policy config
DISTRO ?= "poky"

# Package Management configuration
PACKAGE_CLASSES ?= "package_deb"
# EXTRA_IMAGE_FEATURES += " package-management"

# Extra image configuration defaults
#  "debug-tweaks"   - make an image suitable for development
#                     e.g. ssh root access has a blank password
# EXTRA_IMAGE_FEATURES ?= "debug-tweaks"
INHERIT += "extrausers"
EXTRA_USERS_PARAMS = "\
	useradd rpi; \
	usermod -P pass rpi; \
	usermod -a -G audio rpi; \
  usermod -P pass root"
EXTRA_IMAGE_FEATURES += " allow-root-login"

# Additional image features
USER_CLASSES ?= "buildstats image-mklibs image-prelink"

# Interactive shell configuration
PATCHRESOLVE = "noop"

# Disk Space Monitoring during the build
BB_DISKMON_DIRS ??= "\
    STOPTASKS,${TMPDIR},1G,100K \
    STOPTASKS,${DL_DIR},1G,100K \
    STOPTASKS,${SSTATE_DIR},1G,100K \
    STOPTASKS,/tmp,100M,100K \
    ABORT,${TMPDIR},100M,1K \
    ABORT,${DL_DIR},100M,1K \
    ABORT,${SSTATE_DIR},100M,1K \
    ABORT,/tmp,10M,1K"

# Qemu configuration
PACKAGECONFIG_append_pn-qemu-system-native = " sdl"

# Hostname
hostname_pn-base-files = "bta"

# Disable logos
DISABLE_SPLASH = "1"
DISABLE_RPI_BOOT_LOGO = "1"

CMDLINE_DEBUG = "quiet"

# Boot delay
BOOT_DELAY = "0"
BOOT_DELAY_MS = "0"

# Device mode
# ENABLE_DWC2_PERIPHERAL = "1"
RPI_EXTRA_CONFIG = '\n# Gadget mode \ndtoverlay=dwc2'

# Kernel mudules config
KERNEL_MODULE_AUTOLOAD += "dwc2 g_ether"
MACHINE_ESSENTIAL_EXTRA_RDEPENDS += "kernel-module-dwc2 kernel-module-g-ether"

# SSH over USB
IMAGE_INSTALL_append += " dropbear"

# systemd enable
DISTRO_FEATURES_append += " systemd dbus pam"
DISTRO_FEATURES_BACKFILL_CONSIDERED = "sysvinit"
VIRTUAL-RUNTIME_init_manager = "systemd"
VIRTUAL-RUNTIME_initscripts = ""

# Bluetooth
DISTRO_FEATURES_append += " bluez5 bluetooth pulseaudio"
IMAGE_INSTALL_append += " pulseaudio pulseaudio-server bluez-tools"
IMAGE_INSTALL_append += " alsa-lib alsa-tools alsa-utils"

# Custom recipes
IMAGE_INSTALL_append += " bluez-service bt-connect btn-click"

CONF_VERSION = "1"
```

## src/meta-bt-connect/conf/layer.conf
```bitbake
# We have a conf and classes directory, add to BBPATH
BBPATH .= ":${LAYERDIR}"

# We have recipes-* directories, add to BBFILES
BBFILES += "${LAYERDIR}/recipes-*/*/*.bb \
            ${LAYERDIR}/recipes-*/*/*.bbappend"

BBFILE_COLLECTIONS += "meta-bt-connect"
BBFILE_PATTERN_meta-bt-connect = "^${LAYERDIR}/"
BBFILE_PRIORITY_meta-bt-connect = "6"

LAYERDEPENDS_meta-bt-connect = "core"
LAYERSERIES_COMPAT_meta-bt-connect = "hardknott"
```

## src/meta-bta/conf/layer.conf
```bitbake
# We have a conf and classes directory, add to BBPATH
BBPATH .= ":${LAYERDIR}"

# We have recipes-* directories, add to BBFILES
BBFILES += "${LAYERDIR}/recipes-*/*/*.bb \
            ${LAYERDIR}/recipes-*/*/*.bbappend"

BBFILE_COLLECTIONS += "meta-bttoaux_network"
BBFILE_PATTERN_meta-bttoaux_network = "^${LAYERDIR}/"
BBFILE_PRIORITY_meta-bttoaux_network = "6"

LAYERDEPENDS_meta-bttoaux_network = "core"
LAYERSERIES_COMPAT_meta-bttoaux_network = "hardknott"
```
